## DCENT_OS_Antminer/br2_external_dcentos/configs/dcentos_am3_s19xp_defconfig
```kconfig
# DCENTos Buildroot override — Antminer S19 XP, Amlogic A113D.
# Exact held identity: fw-info model=s19xp/platform=aml/install_type=nand.
BR2_TARGET_GENERIC_HOSTNAME="dcentos-s19xp"
BR2_TARGET_GENERIC_ISSUE="DCENTos Experimental package for exact S19 XP Amlogic identity"
BR2_ROOTFS_OVERLAY="$(BR2_EXTERNAL_DCENTOS_PATH)/board/common/rootfs-overlay $(BR2_EXTERNAL_DCENTOS_PATH)/board/amlogic/rootfs-overlay $(BR2_EXTERNAL_DCENTOS_PATH)/board/amlogic/am3-s19xp/rootfs-overlay"
BR2_ROOTFS_POST_BUILD_SCRIPT="$(BR2_EXTERNAL_DCENTOS_PATH)/board/amlogic/am3-s21/post-build.sh $(BR2_EXTERNAL_DCENTOS_PATH)/board/common/prune-runtime-research-tools.sh"
BR2_ROOTFS_POST_IMAGE_SCRIPT="$(BR2_EXTERNAL_DCENTOS_PATH)/board/amlogic/am3-s21/post-image.sh"
```

## DCENT_OS_Antminer/br2_external_dcentos/packages/dcentos-deploy-lock/Config.in
```kconfig
config BR2_PACKAGE_DCENTOS_DEPLOY_LOCK
	bool "dcentos-deploy-lock"
	help
	  Kernel-backed command serializer for dcentrald boot admission,
	  development deployment, recovery, and recovery-administration
	  operations. The lock is nonblocking and is released by the kernel
	  if the owner dies; no pathname lease is treated as liveness.
```

## DCENT_OS_Antminer/br2_external_dcentos/packages/dcentos-deploy-path/Config.in
```kconfig
config BR2_PACKAGE_DCENTOS_DEPLOY_PATH
	bool "dcentos-deploy-path"
	help
	  Exact-path filesystem helper for persistent deployment recovery.
	  It provides atomic retirement into a private transaction directory,
	  no-clobber hard-link restoration, and an on-filesystem capability probe
	  compatible with the Linux 4.4 Zynq baseline.
```
